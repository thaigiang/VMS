<!DOCTYPE html PUBLIC "-//W3C//DTD XHTML 1.0 Strict//EN"
  "http://www.w3.org/TR/xhtml1/DTD/xhtml1-strict.dtd">
<html xmlns="http://www.w3.org/1999/xhtml" xml:lang="vi" lang="vi">
<head>
	<meta charset="utf-8" />
	<title>FTS - VMS</title>
	<link href="/mchp.css" rel="stylesheet" type="text/css" />
	<script src="/mchp.js" type="text/javascript"></script>
</head>

<body>
<div id="shadow-one"><div id="shadow-two"><div id="shadow-three"><div id="shadow-four">
<div id="page">

<div style="padding:0 0 5px 5px">
	<img href="/index.htm" src="/logo.png" alt="FPT Techlonogy Solutions" />
	<a style="float:right" href="/logout.htm">Thoát</a>
</div>

<div id="title"><div class="right">Cấu hình thiết bị</div></div>

<div id="menu">
<a href="/index.htm">Giới thiệu</a>
<a href="/confignw.htm">Cấu hình mạng</a>
<a href="/confighw.htm">Cấu hình thiết bị</a>
<a href="/configdt.htm">Cấu hình thời gian</a>
<a href="/version.htm">Thông tin phiên bản</a>
<a href="/configpw.htm">Đổi mật khẩu</a>
</div>